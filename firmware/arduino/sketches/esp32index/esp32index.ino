#include <SPI.h>
#include <Wire.h>
#include <Adafruit_GFX.h>
#include <Adafruit_SSD1306.h>
#define BLINKER_BLE
#define OLED_RESET 0
#include <Blinker.h>
BlinkerButton Button1("btn-abc");
BlinkerButton Button2("btn-def");
BlinkerNumber Number1("num1-abc");
BlinkerNumber Number2("num2-abc");
BlinkerNumber Number3("num3-abc");
BlinkerSlider Slider1("Slider_1");
BlinkerSlider Slider2("Slider_2");
BlinkerSlider Slider3("Slider_3");
Adafruit_SSD1306 display(OLED_RESET);
char timer[9] = {'0','0',':','0','0',':','0','0','\0'};
int h=0,m=0,s=0;
bool start_status;
static const unsigned char PROGMEM zhi[] =  {
  0x20,0x00,0x3E,0x7C,0x48,0x44,0x08,0x44,0xFF,0x44,0x14,0x44,0x22,0x7C,0x40,0x00,
  0x1F,0xF0,0x10,0x10,0x10,0x10,0x1F,0xF0,0x10,0x10,0x10,0x10,0x1F,0xF0,0x10,0x10
};
static const unsigned char PROGMEM neng[] =  {
  0x10,0x40,0x24,0x44,0x42,0x48,0xFF,0x70,0x01,0x40,0x00,0x42,0x7E,0x42,0x42,0x3E,
  0x42,0x00,0x7E,0x44,0x42,0x48,0x42,0x70,0x7E,0x40,0x42,0x42,0x4A,0x42,0x44,0x3E
};
static const unsigned char PROGMEM can[] =  {
  0x08,0x00,0x0F,0x78,0x28,0x08,0x7F,0x28,0xA1,0x10,0x17,0x28,0x3A,0xC4,0xCD,0x60,
  0x3F,0xF8,0xC8,0x26,0x0F,0xE0,0x08,0x20,0x0F,0xE8,0x08,0xD0,0x0A,0x30,0x0C,0x08
};
static const unsigned char PROGMEM ju[] =  {
  0x00,0x00,0x1F,0xF0,0x10,0x10,0x10,0x10,0x1F,0xF0,0x10,0x10,0x1F,0xF0,0x10,0x10,
  0x1F,0xF0,0x10,0x10,0x10,0x10,0xFF,0xFE,0x04,0x40,0x08,0x20,0x10,0x10,0x20,0x08
};
static const unsigned char PROGMEM xiao[] =  {
  0x00,0x40,0x22,0x48,0x11,0x48,0x11,0x50,0x80,0x40,0x43,0xF8,0x4A,0x08,0x0A,0x08,
  0x13,0xF8,0x12,0x08,0xE2,0x08,0x23,0xF8,0x22,0x08,0x22,0x08,0x22,0x28,0x02,0x10
};
static const unsigned char PROGMEM du[] =  {
  0x01,0x00,0x3F,0xF8,0x01,0x00,0x1F,0xF0,0x01,0x00,0x7F,0xFC,0x00,0x00,0x1F,0xF0,
  0x12,0x10,0x11,0x10,0xFF,0xFE,0x22,0x10,0x21,0x10,0x3F,0xFC,0x00,0x10,0x00,0x60
};
static const unsigned char PROGMEM he[] =  {
  0x01,0x00,0x02,0x80,0x0C,0x60,0x30,0x18,0xCF,0xE6,0x00,0x00,0x1F,0xF0,0x10,0x10,
  0x1F,0xF0,0x00,0x00,0x3F,0xF8,0x24,0x48,0x24,0x48,0x24,0x48,0xFF,0xFE,0x00,0x00
};
static const unsigned char PROGMEM she[] =  {
  0x00,0x00,0x21,0xF0,0x11,0x10,0x11,0x10,0x01,0x10,0x02,0x0E,0xF4,0x00,0x13,0xF8,
  0x11,0x08,0x11,0x10,0x10,0x90,0x14,0xA0,0x18,0x40,0x10,0xA0,0x03,0x18,0x0C,0x06
};
static const unsigned char PROGMEM ji[] =  {
  0x00,0x40,0x20,0x40,0x10,0x40,0x10,0x40,0x00,0x40,0x00,0x40,0xF7,0xFE,0x10,0x40,
  0x10,0x40,0x10,0x40,0x10,0x40,0x10,0x40,0x14,0x40,0x18,0x40,0x10,0x40,0x00,0x40
};
static const unsigned char PROGMEM zhi2[] =  {
  0x04,0x04,0x24,0x04,0x24,0x04,0x3F,0xA4,0x44,0x24,0x04,0x24,0xFF,0xE4,0x04,0x24,
  0x04,0x24,0x3F,0xA4,0x24,0xA4,0x24,0xA4,0x26,0x84,0x25,0x04,0x04,0x14,0x04,0x08
};
static const unsigned char PROGMEM zuo[] =  {
  0x09,0x00,0x09,0x00,0x09,0x00,0x11,0xFE,0x12,0x80,0x32,0x80,0x34,0x80,0x50,0xF8,
  0x90,0x80,0x10,0x80,0x10,0x80,0x10,0xFC,0x10,0x80,0x10,0x80,0x10,0x80,0x10,0x80
};
static const unsigned char PROGMEM yu[] =  {
  0x20,0x20,0x10,0x20,0x00,0x20,0xFE,0x50,0x20,0x50,0x20,0x88,0x3D,0x04,0x26,0x02,
  0x24,0x60,0x24,0x10,0x24,0x00,0x24,0xC0,0x44,0x20,0x54,0x10,0x88,0x08,0x00,0x00
};
static const unsigned char PROGMEM shuo[] =  {
  0x20,0x08,0x20,0x3C,0x3B,0xC0,0x22,0x00,0x42,0x20,0x7A,0x20,0xA2,0x20,0x23,0xFE,
  0xF8,0x20,0x20,0x20,0x21,0x28,0x21,0x24,0x2A,0x22,0x34,0x22,0x20,0xA0,0x00,0x40
};
void button1_callback(const String & state)
{
    BLINKER_LOG("get button state: ", state);
    start_status=1;
}
void button2_callback(const String & state)
{
    BLINKER_LOG("get button state: ", state);
    start_status=0;
    digitalWrite(5,LOW);
}
void slider1_callback(int32_t value)
{
    s=value;
    BLINKER_LOG("get slider value: ", value);
}
void slider2_callback(int32_t value)
{
    m=value;
    BLINKER_LOG("get slider value: ", value);
}

void slider3_callback(int32_t value)
{
    h=value;
    BLINKER_LOG("get slider value: ", value);
}

void setup() {
  Serial.begin(9600);
  Button1.attach(button1_callback);
  Button2.attach(button2_callback);
  Slider1.attach(slider1_callback);
  Slider2.attach(slider2_callback);
  Slider3.attach(slider3_callback);
  pinMode(18,INPUT);
  pinMode(5,OUTPUT);
  pinMode(12,INPUT_PULLUP);
  pinMode(13,INPUT_PULLUP);
  pinMode(14,INPUT_PULLUP);
  
  BLINKER_DEBUG.stream(Serial);
  Blinker.begin();
  
  display.begin(SSD1306_SWITCHCAPVCC, 0x3C);
  display.clearDisplay();
  display.drawBitmap(0, 0,  zhi, 16, 16, 1);
  display.drawBitmap(16, 0,  neng, 16, 16, 1);
  display.drawBitmap(32, 0,  can, 16, 16, 1);
  display.drawBitmap(48, 0,  ju, 16, 16, 1);
  display.drawBitmap(64, 0,  xiao, 16, 16, 1);
  display.drawBitmap(80, 0,  du, 16, 16, 1);
  display.drawBitmap(96, 0,  he, 16, 16, 1);
  display.drawBitmap(0, 16,  she, 16, 16, 1);
  display.drawBitmap(16, 16,  ji, 16, 16, 1);
  display.drawBitmap(32, 16,  zhi2, 16, 16, 1);
  display.drawBitmap(48, 16,  zuo, 16, 16, 1);
  display.drawBitmap(80, 16,  yu, 16, 16, 1);
  display.drawBitmap(96, 16,  shuo, 16, 16, 1);
  display.display();
  delay(4000);
  display.clearDisplay();
  display.setTextSize(2);
  display.setTextColor(WHITE);
  display.setCursor(16,13);
  display.println(timer);
  display.display();
}

void loop() {
  Blinker.run();
  Number1.print(s);
  Number2.print(m);
  Number3.print(h);
  display.setTextSize(2);
  display.setTextColor(WHITE);
  timer[0]=h/10+'0';timer[1]=h%10+'0';
  timer[3]=m/10+'0';timer[4]=m%10+'0';
  timer[6]=s/10+'0';timer[7]=s%10+'0';
  display.setCursor(16,13);
  display.clearDisplay();
  display.println(timer);
  //Serial.println(m);
  display.display();
  if(digitalRead(14)==LOW){
    s=s+30;
    if(s==60){
      s=0;
      m=m+1;
      if(m==60){
        m=0;
        h++;
        if(h==24){
          h=0;
        }
      }
    }
    timer[0]=h/10+'0';timer[1]=h%10+'0';
    timer[3]=m/10+'0';timer[4]=m%10+'0';
    timer[6]=s/10+'0';timer[7]=s%10+'0';
    display.setCursor(16,13);
    display.clearDisplay();
    display.println(timer);
    //Serial.println(m);
    display.display();
  }
  if(digitalRead(13)==LOW){
    if(s!=0||m!=0||h!=0){
      s=s-30;
    if(s==-30){
      s=30;
      m--;
      if(m==-1){
        m=0;
        h--;
        if(h==-1){
          h=0;
        }
      }
    }
    timer[0]=h/10+'0';timer[1]=h%10+'0';
    timer[3]=m/10+'0';timer[4]=m%10+'0';
    timer[6]=s/10+'0';timer[7]=s%10+'0';
    display.setCursor(16,13);
    display.clearDisplay();
    display.println(timer);
    //Serial.println(m);
    display.display();
    }
  }
  if(digitalRead(12)==LOW){
    start_status=1;
  }
  if(timer[0]=='0'&&timer[1]=='0'&&timer[3]=='0'&&timer[4]=='0'&&timer[6]=='0'&&timer[7]=='0'){
    start_status=0;
    digitalWrite(5,LOW);
  }
  if(start_status){
    if(digitalRead(18)==HIGH){
      digitalWrite(5,LOW);
      char timeleft[1]={'8'};
      for(int i =0;i<=8;i++){
        display.clearDisplay();
        display.setCursor(16,13);
        display.setTextSize(2);
        display.println(timer);
        display.setCursor(112,20);
        display.setTextSize(1.5);
        display.println(timeleft[0]);
        display.display();
        timeleft[0]--;
        delay(1000);
      }
    }
    display.clearDisplay();
    start();
  }
  delay(100);
  }
void start(){
  display.setTextSize(2);
  digitalWrite(5,HIGH);
  s--;
    if(s==-1){
      s=59;
      m--;
      if(m==-1){
        m=0;
        h--;
        if(h==-1){
          
          h=0;
        }
      }
    }
    timer[0]=h/10+'0';timer[1]=h%10+'0';
    timer[3]=m/10+'0';timer[4]=m%10+'0';
    timer[6]=s/10+'0';timer[7]=s%10+'0';
    display.setCursor(16,13);
    display.clearDisplay();
    display.println(timer);
    //Serial.println(m);
    display.display();
    delay(900);
}
